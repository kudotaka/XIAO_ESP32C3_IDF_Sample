## components/m5unit/Kconfig
```kconfig
menu "M5Unit enable"
    config SOFTWARE_UNIT_ENV2_SUPPORT
        bool "UNIT-ENV2-Hardware"
        default n
    config SOFTWARE_UNIT_SK6812_SUPPORT
        bool "UNIT-SK6812-Hardware"
        default n
    config SOFTWARE_UNIT_BUTTON_SUPPORT
        bool "UNIT-BUTTON-Hardware"
        default n
    config SOFTWARE_UNIT_LED_SUPPORT
        bool "UNIT-LED-Hardware"
        default n
    config SOFTWARE_UNIT_4DIGIT_DISPLAY_SUPPORT
        bool "UNIT-4DigitDisplay"
        default n
    config SOFTWARE_UNIT_6DIGIT_DISPLAY_SUPPORT
        bool "UNIT-6DigitDisplay"
        default n
    config SOFTWARE_I2C_LCD_ST7032_SUPPORT
        bool "I2C-LCD-ST7032-Hardware"
        default n
    choice
        prompt "Set Model"
        depends on SOFTWARE_I2C_LCD_ST7032_SUPPORT
        default SOFTWARE_MODEL_AQM0802
        config SOFTWARE_MODEL_AQM0802
            bool "MODEL-AQM0802"
        config SOFTWARE_MODEL_AQM1602
            bool "MODEL-AQM1602"
    endchoice
    choice
        prompt "Use Backlight"
        depends on SOFTWARE_I2C_LCD_ST7032_SUPPORT
        default SOFTWARE_NOT_USE_BACKLIGHT
        config SOFTWARE_USE_BACKLIGHT
            bool "USE-BACKLIGHT"
        config SOFTWARE_NOT_USE_BACKLIGHT
            bool "NOT-USE-BACKLIGHT"
    endchoice
endmenu
```

## components/xiao/Kconfig
```kconfig
menu "My Original (SEEED XIAO)"

    config WIFI_SSID
        string "WiFi SSID"
        default "AWSWorkshop"
        help
            SSID (network name) for the example to connect to.

    config WIFI_PASSWORD
        string "WiFi Password"
        default "IoTP$AK1t"
        help
            WiFi password (WPA or WPA2) for the example to use.

            Can be left blank if the network has no security set.

endmenu

menu "Seeed XIAO hardware enable"
    choice
        prompt "Set Model"
        default SOFTWARE_MODEL_SEEED_XIAO_ESP32C3
        config SOFTWARE_MODEL_SEEED_XIAO_ESP32C3
            bool "MODEL-Seeed XIAO ESP32C3"
        config SOFTWARE_MODEL_SEEED_XIAO_RP2040
            bool "MODEL-Seeed XIAO RP2040"
    endchoice
    config SOFTWARE_EXPANSION_BOARD_SUPPORT
        bool "Expansion Board"
        default n
    config SOFTWARE_GROVE_SHIELD_SUPPORT
        bool "Grove Shield"
        default n
    config SOFTWARE_BUZZER_SUPPORT
        bool "BUZZER-Hardware"
        default n
    config SOFTWARE_BUTTON_SUPPORT
        bool "BUTTON-Hardware"
        default n
    config SOFTWARE_SSD1306_SUPPORT
        bool "I2C-UNIT-Display(SSD1306/SSD1315)"
        default n
        help
            TODO: LVGL configuration
    config SOFTWARE_RTC_SUPPORT
        bool "I2C-UNIT-RTC(BM8563)"
        default n
    config SOFTWARE_EXTERNAL_LED_SUPPORT
        bool "IO-UNIT-EXTERNAL-LED"
        default n
endmenu
```
